## src/drivers/differential_pressure/servo_gimbal/Kconfig
```kconfig
menuconfig DRIVERS_SERVO_GIMBAL
	bool "servo_gimbal"
	default n
	---help---
		Enable support for servo_gimbal
```

## src/examples/work_item_new/Kconfig
```kconfig
menuconfig EXAMPLES_WORK_ITEM_NEW
	bool "work_item_new"
	default n
	---help---
		Enable support for work_item
```
